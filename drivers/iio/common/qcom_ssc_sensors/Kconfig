## drivers/iio/common/qcom_ssc_sensors/Kconfig
```kconfig
#
# Qualcomm SSC IIO
#
# When adding new entries keep the list in alphabetical order

config IIO_QCOM_SSC
	tristate "Qualcomm Snapdragon Sensor Core"
        depends on ARCH_QCOM
	depends on QCOM_RPROC_COMMON
	help
          Say yes here to build core support for Qualcomm Snapdragon Sensor
	  Core (SSC).

	  To compile this driver as a module, choose M here: the
	  module will be called qcom_ssc.
```
